/*
 * Copyright (c) 2024 Realtek Semiconductor Corp.
 *
 * SPDX-License-Identifier: Apache-2.0
 */

/* DUT moved to uart2 (PA25 TX / PA26 RX) — that pair is wired on the bench.
 * uart2 already has dmas/dma-names declared in amebag2.dtsi, so the overlay
 * only needs to set pinctrl and enable the node.
 */

dut: &uart2 {
	pinctrl-0 = <&uart2_default>;
	pinctrl-names = "default";
	status = "okay";
};

&dma {
	status = "okay";
};
