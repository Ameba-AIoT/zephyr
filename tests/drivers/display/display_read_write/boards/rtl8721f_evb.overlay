/*
 * Copyright (c) 2024 Realtek Semiconductor Corp.
 *
 * SPDX-License-Identifier: Apache-2.0
 */

/* EVB V2 */

// #include "rtl8721f_evb_rgb_st7262.dtsi"
#include "rtl8721f_evb_srgb_st7272a.dtsi"

/ {
	chosen {
		zephyr,display = &zephyr_lcdc;
	};

};

