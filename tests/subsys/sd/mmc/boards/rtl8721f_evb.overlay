/*
 * Copyright (c) 2025 Realtek Semiconductor Corp.
 *
 * SPDX-License-Identifier: Apache-2.0
 */

/ {
	aliases {
		sdhc0 = &sdhc0;
	};
};

sdh_ctl: &sdhc0 {
	pinctrl-0 = <&sdhc0_default>;
	pinctrl-names = "default";
	cd-gpios = <&gpiob 19 (GPIO_ACTIVE_LOW | GPIO_PULL_UP)>;
	status = "okay";
	mmc {
		compatible = "zephyr,mmc-disk";
		disk-name = "SD";
		bus-width = <4>;
		status = "okay";
	};
};
