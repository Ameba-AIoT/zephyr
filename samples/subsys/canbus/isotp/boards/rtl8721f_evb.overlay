/*
 * Copyright (c) 2025 Realtek Semiconductor Corp.
 *
 * SPDX-License-Identifier: Apache-2.0
 */

/ {
	chosen {
		zephyr,canbus = &a2c0;
	};
};

&a2c0 {
	pinctrl-0 = <&a2c0_default>;
	pinctrl-names = "default";
	status = "okay";
};
