#
# Copyright (c) 2025 Realtek Semiconductor Corp.
#
# SPDX-License-Identifier: Apache-2.0
#

/ {
	chosen {
		zephyr,code-partition = &slot0_partition;
		zephyr,uart-mcumgr = &uart0;
	};
};

&spic {
	status = "okay";
};

&uart0 {
	pinctrl-0 = <&uart0_default>;
	pinctrl-names = "default";
	status = "okay";
};
