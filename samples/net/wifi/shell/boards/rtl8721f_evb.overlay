/*
 * Copyright (c) 2024 Realtek Semiconductor Corp.
 *
 * SPDX-License-Identifier: Apache-2.0
 */

/ {
	chosen {
		zephyr,settings-partition = &storage_partition;
	};
};

&wifi0 {
	status = "okay";
};

&wifi1 {
	status = "okay";
};
