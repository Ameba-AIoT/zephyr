## dts/bindings/ethernet/realtek,ameba-eth.yaml
```yaml
# Copyright (c) 2025 Realtek Semiconductor Corp.
# SPDX-License-Identifier: Apache-2.0

description: AMEBA Ethernet

compatible: "realtek,ameba-eth"

include: [pinctrl-device.yaml, ethernet-controller.yaml]

properties:
  pinctrl-names:
    required: true

  phy-connection-type:
    required: true

  phy-handle:
    required: true

  ref-clk-output-gpios:
    type: phandle-array
    description: |
      GPIO to output RMII Clock.
```

## dts/bindings/ethernet/realtek,ameba-ethernet.yaml
```yaml
# Copyright (c) 2025 Realtek Semiconductor Corp.
# SPDX-License-Identifier: Apache-2.0

description: AMEBA Ethernet

compatible: "realtek,ameba-ethernet"

include: ["base.yaml"]

properties:
  reg:
    required: true

  clocks:
    required: true
```

## dts/bindings/ethernet/realtek,ameba-mac.yaml
```yaml
# Copyright (c) 2025 Realtek Semiconductor Corp.
# SPDX-License-Identifier: Apache-2.0

description: |
  ref-clk-output-gpios:
    Specify the GPIO pin for Reference Clock output. This GPIO will be configured
    to output ref clk, commonly used for PHY (Ethernet) applications.

    Format:
      <&gpio_controller gpio_pin (flags)>

    - gpio_controller: GPIO controller phandle
    - gpio_pin:        Pin number (e.g., 3/5/12, depends on chip)
    - flags:           Pin flags, e.g., GPIO_ACTIVE_HIGH, GPIO_PULL_UP

  Example:
    ref-clk-output-gpios = <&gpioa 12 GPIO_ACTIVE_HIGH>;

compatible: "realtek,ameba-mac"

include:
  - pinctrl-device.yaml
  - ethernet-controller.yaml
  - realtek,ameba-pmu.yaml

properties:
  pinctrl-names:
    required: true

  phy-connection-type:
    required: true

  phy-handle:
    required: true

  ref-clk-output-gpios:
    type: phandle-array
    description: |
      GPIO to output RMII Clock.
```

## dts/bindings/flash_controller/realtek,amebapro2-flash-controller.yaml
```yaml
description: AMEBA Family flash controller

compatible: "realtek,amebapro2-flash-controller"

include: flash-controller.yaml
```

## dts/bindings/gpio/realtek,ameba-gpio.yaml
```yaml
# Copyright (c) 2024 Realtek Semiconductor Corp.
# SPDX-License-Identifier: Apache-2.0

description: Realtek Ameba GPIO controller

compatible: "realtek,ameba-gpio"

include:
  - gpio-controller.yaml
  - base.yaml
  - realtek,ameba-pmu.yaml

properties:
  reg:
    required: true

  interrupts:
    required: true

  port:
    type: int
    required: true
    description: |
      GPIO port index of the controller (e.g. 0 for GPIOA, 1 for GPIOB, etc).

  "#gpio-cells":
    const: 2

gpio-cells:
  - pin
  - flags
```

## dts/bindings/gpio/realtek,amebapro2-gpio.yaml
```yaml
# Copyright (c) 2024 Realtek Semiconductor Corp.
# SPDX-License-Identifier: Apache-2.0

description: Realtek Amebapro2 GPIO controller

compatible: "realtek,amebapro2-gpio"

include: [gpio-controller.yaml, base.yaml]

properties:
  reg:
    required: true

  interrupts:
    required: true

  "#gpio-cells":
    const: 2

gpio-cells:
  - pin
  - flags
```

## dts/bindings/i2c/realtek,ameba-i2c.yaml
```yaml
# Copyright (c) 2024 Realtek Semiconductor Corp.
# SPDX-License-Identifier: Apache-2.0

description: Ameba I2C

compatible: "realtek,ameba-i2c"

include: [i2c-controller.yaml, pinctrl-device.yaml]

properties:
  reg:
    required: true

  pinctrl-0:
    required: false

  pinctrl-names:
    required: false
```

## dts/bindings/i2c/realtek,amebapro2-i2c.yaml
```yaml
# Copyright (c) 2024 Realtek Semiconductor Corp.
# SPDX-License-Identifier: Apache-2.0

description: Amebapro2 I2C

compatible: "realtek,amebapro2-i2c"

include: [i2c-controller.yaml, pinctrl-device.yaml]

properties:
  reg:
    required: true

  interrupts:
    required: true
```

## dts/bindings/i2s/realtek,ameba-i2s.yaml
```yaml
# Copyright (c) 2024 Realtek Semiconductor Corp.
# SPDX-License-Identifier: Apache-2.0

description: AMEBA I2S controller

compatible: "realtek,ameba-i2s"

include: [i2s-controller.yaml, pinctrl-device.yaml]

properties:
  reg:
    required: true

  interrupts:
    required: true

  dmas:
    required: false

  dma-names:
    required: true

  pinctrl-0:
    required: true

  pinctrl-names:
    required: true
```

## dts/bindings/mipi-dbi/realtek,ameba-lcdc.yaml
```yaml
# Copyright (c) 2025 Realtek Semiconductor Corp.
# SPDX-License-Identifier: Apache-2.0

description: Ameba LCDC Display Controller.
compatible: "realtek,ameba-lcdc"

include: ["mipi-dbi-controller.yaml", "pinctrl-device.yaml"]

properties:
  reg:
    required: true

  interrupts:
    required: true

  clocks:
    required: true
```

## dts/bindings/mipi-dbi/realtek,mipi-dbi-ameba-lcdc.yaml
```yaml
# Copyright (c) 2025 Realtek Semiconductor Corp.
# SPDX-License-Identifier: Apache-2.0

description: AMEBA MCU LCD controller

compatible: "realtek,mipi-dbi-ameba-lcdc"

include: [mipi-dbi-controller.yaml, pinctrl-device.yaml]

properties:
  interrupts:
    required: true

  clocks:
    required: true

  backlight-gpios:
    type: phandle-array
    # required: true
    description:
      Backlight on/off GPIO pin.

  reset-gpios:
    type: phandle-array
    required: true
    description: |
      Reset GPIO pin.

  data-bus-width:
    type: string
    #required: true
    #mipi-mode = "MIPI_DBI_MODE_8080_BUS_16_BIT";
    enum:
      - "8-bit"  #RGB565, RGB888
      - "16-bit" #RGB565
      - "24-bit" #RGB888
    description:
      LCD data bus width.

  swap-bytes:
    type: boolean
    description: |
      Swap bytes while transferring pixel data. This is only valid for 8-bit RGB565 format.

  im-gpios:
    type: phandle-array
    description: |
      Four GPIO pins for configuring ILI9806 interface mode (IM3 to IM0).
      The pins must be configured as output and set according to the desired bit width:
        - 8-bit mode: [0, 0, 0, 0] (IM3=0, IM2=0, IM1=0, IM0=0)
        - 16-bit mode: [0, 0, 0, 1] (IM3=0, IM2=0, IM1=0, IM0=1)
        - 24-bit mode: [0, 0, 1, 0] (IM3=0, IM2=0, IM1=1, IM0=0)
      The array must be ordered from IM3 (highest bit) to IM0 (lowest bit).

      Example:

          im-gpios = <&gpio0 14 GPIO_ACTIVE_HIGH>, // IM3
                      <&gpio0 13 GPIO_ACTIVE_HIGH>,  // IM2
                      <&gpio0 16 GPIO_ACTIVE_HIGH>,  // IM1
                      <&gpio0 17 GPIO_ACTIVE_HIGH]>;   // IM0
```

## dts/bindings/misc/realtek,ameba-mjpeg.yaml
```yaml
# SPDX-License-Identifier: Apache-2.0
#
# Copyright (c) 2025 Realtek Semiconductor Corporation
#

description: AMEBA Motion Joint Photographic Experts Group

compatible: "realtek,ameba-mjpeg"

include: base.yaml

properties:
  reg:
    required: true
  interrupts:
    required: true
  clocks:
    required: true
```

## dts/bindings/misc/realtek,ameba-ppe.yaml
```yaml
# SPDX-License-Identifier: Apache-2.0
#
# Copyright (c) 2025 Realtek Semiconductor Corporation
#

description: AMEBA Pixel Processing Engine

compatible: "realtek,ameba-ppe"

include: base.yaml

properties:
  reg:
    required: true
  interrupts:
    required: true
  clocks:
    required: true
```

## dts/bindings/pinctrl/realtek,ameba-pinctrl.yaml
```yaml
# Copyright (c) 2024 Realtek Semiconductor Corp.
# SPDX-License-Identifier: Apache-2.0

description: |
  Realtek Ameba pinctrl node.

compatible: "realtek,ameba-pinctrl"

include: base.yaml

properties:
  reg:
    required: false
child-binding:
  description: |
    Realtek Ameba pin controller pin group for a pinctrl state.
  child-binding:
    description: |
      Realtek Ameba pin controller pin configuration node.
    include:
      - name: pincfg-node.yaml
        property-allowlist:
          - bias-disable
          - bias-pull-down
          - bias-pull-up
          - input-schmitt-disable
    properties:
      pinmux:
        required: true
        type: array
        description: |
          Pin mux selections for this group. An array of pins sharing the same group properties.
          Each element of the array is an integer constructed from the pin number and the alternative function of the pin.
      slew-rate:
        default: "fast"
        type: string
        enum:
          - "fast"
          - "slow"
        description: |
          Pin output slew rate.If not set, default value is fast.
      drive-strength:
        default: "high"
        type: string
        description: |
          Drive strength of the output pin.If not set, default value is high.
        enum:
          - "high"
          - "low"
      digital-input:
        type: boolean
        description: |
          Enable the digital input function.
      swd-off:
        type: boolean
        description: |
          Disable the SWD function.
```

## dts/bindings/power/realtek,ameba-pmu.yaml
```yaml
# Copyright (c) 2025 Realtek Semiconductor Corp.
# SPDX-License-Identifier: Apache-2.0

# realtek,ameba-pmu.yaml
description: |
  Realtek Ameba PMU (Power Management Unit) / Wakeup controller

  The PMU controls power domains and can wake up the SoC from low-power
  states using dedicated peripherals as wakeup sources.

  Peripherals that can act as wakeup sources (such as timers, RTC, GPIO, etc.)
  must specify the wakeup-source-id property on their respective nodes.

    rtc: rtc@... {
      ...
      wakeup-source-id = <WAKE_SRC_RTC>;
      ...
    };

  To support this property, the device binding file should include this binding:

    include:
      - ...
      - realtek,ameba-pmu.yaml

  A peripheral will actually be used as a wakeup source only when the standard
  boolean property 'wakeup-source' is also present, e.g.:

    &rtc {
      ...
      wakeup-source;
      ...
    };

  The PMU wakeup source IDs that can be enabled are defined in the
  zephyr/include/zephyr/dt-bindings/power/ameba*_power.h header file.

compatible: "realtek,ameba-pmu"

include:
  - name: base.yaml

properties:
  wakeup-source-id:
    type: int
    description: wakeup-source-id specifier
```

## dts/bindings/rng/realtek,amebapro2-trng.yaml
```yaml
# Copyright (c) 2024 Realtek Semiconductor Corp.
# SPDX-License-Identifier: Apache-2.0

description: AmebaPro2 TRNG (True Random Number Generator)

compatible: "realtek,amebapro2-trng"

include: base.yaml

properties:
  reg:
    required: true
```

## dts/bindings/rtc/realtek,ameba-rtc.yaml
```yaml
# Copyright (c) 2024 Realtek Semiconductor Corp.
# SPDX-License-Identifier: Apache-2.0

description: AMEBA RTC

compatible: "realtek,ameba-rtc"

include: rtc.yaml

properties:
  reg:
    required: true
```

## dts/bindings/sdhc/realtek,ameba-sdhc.yaml
```yaml
# SPDX-License-Identifier: Apache-2.0
#
# Copyright (c) 2025 Realtek Semiconductor Corporation
#

description: AMEBA SD Host controller

compatible: "realtek,ameba-sdhc"

include:
  - sdhc.yaml
  - pinctrl-device.yaml
  - realtek,ameba-pmu.yaml

properties:
  reg:
    required: true

  clocks:
    required: true

  interrupts:
    required: true

  cd-gpios:
    type: phandle-array
    description: Card detect pin.

  pinctrl-0:
    required: true

  pinctrl-names:
    required: true

  bus-width:
    type: int
    default: 4
    description: SD bus width in bits
    enum:
      - 1
      - 4
```

## dts/bindings/serial/realtek,ameba-uart.yaml
```yaml
# Copyright (c) 2024 Realtek Semiconductor Corp.
# SPDX-License-Identifier: Apache-2.0

description: Ameba UART
compatible: "realtek,ameba-uart"

include: [uart-controller.yaml, pinctrl-device.yaml]

bus: uart

properties:
  reg:
    required: true

  clocks:
    required: true

  interrupts:
    required: false

  pinctrl-0:
    required: false

  pinctrl-1:
    required: false

  pinctrl-names:
    required: false
```

## dts/bindings/serial/realtek,amebadplus-uart.yaml
```yaml
# Copyright (c) 2024 Realtek Semiconductor Corp.
# SPDX-License-Identifier: Apache-2.0

description: AMEBADPLUS UART.
compatible: "realtek,amebadplus-uart"

include: [uart-controller.yaml, base.yaml, pinctrl-device.yaml]

bus: uart

properties:
  reg:
    required: true

  clocks:
    required: true

  interrupts:
    required: true

  pinctrl-0:
    required: true

  pinctrl-1:
    required: false

  pinctrl-names:
    required: true

  flow-ctrl:
    type: boolean
    description: |
      Enable cts and rts or not.
```

## dts/bindings/serial/realtek,amebapro2-loguart.yaml
```yaml
# Copyright (c) 2024 Realtek Semiconductor Corp.
# SPDX-License-Identifier: Apache-2.0

description: AmebaPro2 LOGUART
compatible: "realtek,amebapro2-loguart"

include: [uart-controller.yaml, base.yaml, pinctrl-device.yaml]

bus: uart

properties:
  reg:
    required: true

  current-speed:
    required: true

  interrupts:
    required: true
```

## dts/bindings/spi/realtek,ameba-spi.yaml
```yaml
# Copyright (c) 2024 Realtek Semiconductor Corp.
# SPDX-License-Identifier: Apache-2.0

description: Ameba SPI

compatible: "realtek,ameba-spi"

include: [spi-controller.yaml, pinctrl-device.yaml]

properties:
  reg:
    required: true

  pinctrl-0:
    required: false

  pinctrl-names:
    required: false
```

## dts/bindings/spi/realtek,amebapro2-spi.yaml
```yaml
# Copyright (c) 2024 Realtek Semiconductor Corp.
# SPDX-License-Identifier: Apache-2.0

description: Amebapro2 SPI

compatible: "realtek,amebapro2-spi"

include: [spi-controller.yaml, pinctrl-device.yaml]

properties:
  reg:
    required: true

  interrupts:
    required: true
```

## dts/bindings/usb/realtek,ameba-udc.yaml
```yaml
# Copyright (c) 2024 Realtek Semiconductor Corp.
# SPDX-License-Identifier: Apache-2.0

description: Realtek Ameba USB Device controller

compatible: "realtek,ameba-udc"

include: ["snps,dwc2.yaml", pinctrl-device.yaml]

bus: usb

properties:
  reg:
    required: true

  interrupts:
    required: true

  pinctrl-0:
    required: true

  pinctrl-names:
    required: true
```

## dts/bindings/video/realtek,amebapro2-video.yaml
```yaml
# Copyright (c) 2024 Realtek Semiconductor Corp.
# SPDX-License-Identifier: Apache-2.0

description: Amebapro2 Video

compatible: "realtek,amebapro2-video"

include: [base.yaml]

properties:
  reg:
    required: true

  interrupts:
    required: true
```
