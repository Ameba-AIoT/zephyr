## dts/bindings/watchdog/realtek,ameba-watchdog.yaml
```yaml
# Copyright (c) 2024 Realtek Semiconductor Corp.
# SPDX-License-Identifier: Apache-2.0

description: Ameba watchdog

compatible: "realtek,ameba-watchdog"

include: base.yaml

properties:
  reg:
    required: true
```

## samples/drivers/display/boards/rtl8721f_evb.conf
```kconfig
# Copyright (c) 2025 Realtek Semiconductor Corp.
#
# SPDX-License-Identifier: Apache-2.0

CONFIG_GPIO=y
```

## samples/net/dhcpv4_client/boards/rtl8721f_evb.conf
```kconfig
#
# Copyright(c) 2025 Realtek Semiconductor Corp.
#
# SPDX-License-Identifier: Apache-2.0
#
CONFIG_NET_L2_ETHERNET=y
CONFIG_MDIO_SHELL=n
CONFIG_NET_LOG=y
CONFIG_NET_SHELL=y
CONFIG_NET_CORE_LOG_LEVEL_DBG=n
CONFIG_NET_STATISTICS=n
# To avoid loss of UART printing information
CONFIG_LOG_BUFFER_SIZE=16384
CONFIG_NET_IPV4_LOG_LEVEL_DBG=n
```

## samples/net/dns_resolve/boards/rtl8721f_evb.conf
```kconfig
#
# Copyright(c) 2025 Realtek Semiconductor Corp.
#
# SPDX-License-Identifier: Apache-2.0
#
CONFIG_NET_L2_ETHERNET=y
CONFIG_NET_LOG=y
CONFIG_NET_SHELL=y

# IPv4 address of develop boards
CONFIG_NET_CONFIG_MY_IPV4_ADDR="192.168.3.12"
# IPv4 address of AP
CONFIG_NET_CONFIG_PEER_IPV4_ADDR="192.168.3.1"
# Use local dnsmasq server for testing
CONFIG_DNS_SERVER1=""
CONFIG_DNS_SERVER2="192.168.3.1:53"

CONFIG_NET_CORE_LOG_LEVEL_DBG=n
CONFIG_NET_STATISTICS=n
# To avoid loss of UART printing information
CONFIG_LOG_BUFFER_SIZE=16384
CONFIG_NET_IPV4_LOG_LEVEL_DBG=n
```

## samples/net/ipv4_autoconf/boards/rtl8721f_evb.conf
```kconfig
#
# Copyright(c) 2025 Realtek Semiconductor Corp.
#
# SPDX-License-Identifier: Apache-2.0
#
CONFIG_NET_L2_ETHERNET=y
CONFIG_MDIO_SHELL=n
CONFIG_NET_LOG=y
CONFIG_NET_SHELL=y
CONFIG_NET_PKT_RX_COUNT=20
CONFIG_NET_PKT_TX_COUNT=20
CONFIG_NET_BUF_RX_COUNT=30
CONFIG_NET_BUF_TX_COUNT=30
```

## samples/net/stats/boards/rtl8721f_evb.conf
```kconfig
#
# Copyright(c) 2025 Realtek Semiconductor Corp.
#
# SPDX-License-Identifier: Apache-2.0
#
CONFIG_NET_L2_ETHERNET=y
CONFIG_MDIO_SHELL=n
CONFIG_NET_LOG=y
CONFIG_NET_SHELL=y
```

## samples/subsys/mgmt/mcumgr/smp_svr/boards/rtl8721f_evb.conf
```kconfig
#
# Copyright (c) 2025 Realtek Semiconductor Corp.
#
# SPDX-License-Identifier: Apache-2.0
#

CONFIG_UART_MCUMGR_RX_BUF_SIZE=256
CONFIG_BASE64=y
CONFIG_CRC=y
CONFIG_MCUMGR_TRANSPORT_UART=y
CONFIG_CONSOLE=y
CONFIG_UART_CONSOLE_MCUMGR=y
```

## samples/subsys/mgmt/mcumgr/smp_svr/boards/rtl8721f_evb_mcuboot.conf
```kconfig
#
# Copyright (c) 2025 Realtek Semiconductor Corp.
#
# SPDX-License-Identifier: Apache-2.0
#

CONFIG_UART_MCUMGR_RX_BUF_SIZE=256
CONFIG_MCUMGR_TRANSPORT_NETBUF_SIZE=1024
CONFIG_BASE64=y
CONFIG_CRC=y
CONFIG_MCUMGR_TRANSPORT_UART=y
CONFIG_CONSOLE=y
CONFIG_UART_CONSOLE_MCUMGR=y
# Enable confirm km4ns image in test state
CONFIG_MCUMGR_GRP_IMG_ALLOW_CONFIRM_NON_ACTIVE_IMAGE_ANY=y

CONFIG_MCUBOOT_IMGTOOL_SIGN_VERSION="0.0.0+0"
```

## samples/subsys/settings/boards/rtl8721f_evb.conf
```kconfig
#
# Copyright (c) 2025 Realtek Semiconductor Corp.
#
# SPDX-License-Identifier: Apache-2.0
#

CONFIG_NVS=n
CONFIG_ZMS=y
CONFIG_ZMS_LOOKUP_CACHE=y
CONFIG_ZMS_LOOKUP_CACHE_SIZE=512
```

## soc/arm/arm/sheipa/Kconfig.defconfig.series
```kconfig
# Kconfig - Realtek Sheipa configuration options
#
# Copyright (c) 2018-2019 Realtek Semiconductor Corp.
#
# SPDX-License-Identifier: Apache-2.0
#
# Licensed under the Apache License, Version 2.0 (the "License");
# you may not use this file except in compliance with the License.
# You may obtain a copy of the License at
#
#     http://www.apache.org/licenses/LICENSE-2.0
#
# Unless required by applicable law or agreed to in writing, software
# distributed under the License is distributed on an "AS IS" BASIS,
# WITHOUT WARRANTIES OR CONDITIONS OF ANY KIND, either express or implied.
# See the License for the specific language governing permissions and
# limitations under the License.
#

if SOC_SERIES_SHEIPA

config SOC_SERIES
        default "sheipa"

config SYS_CLOCK_HW_CYCLES_PER_SEC
        default 25000000

source "soc/arm/arm/sheipa/Kconfig.defconfig.sheipa*"

endif
```

## soc/arm/arm/sheipa/Kconfig.defconfig.sheipa_km4
```kconfig
if SOC_SHEIPA_KM4

config SOC
	default "sheipa_km4"

config NUM_IRQS
	default 96

endif
```

## soc/arm/arm/sheipa/Kconfig.series
```kconfig
config SOC_SERIES_SHEIPA
	bool "ARM SEHIPA MCU Series"
	select ARM
	select SOC_FAMILY_ARM
	help
	    Enable support for ARM SHEIPA MCU Series
```

## soc/arm/realtek_ameba/Kconfig
```kconfig
# Copyright (c) 2024 Realtek Semiconductor Corp.
# SPDX-License-Identifier: Apache-2.0

config SOC_FAMILY_REALTEK_AMEBA
	bool
	select BUILD_OUTPUT_HEX

if SOC_FAMILY_REALTEK_AMEBA

config SOC_FAMILY
	string
	default "realtek_ameba"

rsource "*/Kconfig.soc"

endif # SOC_FAMILY_REALTEK_AMEBA
```

## soc/arm/realtek_ameba/Kconfig.soc
```kconfig
# Copyright (c) 2016 Open-RnD Sp. z o.o.
# SPDX-License-Identifier: Apache-2.0

rsource "*/Kconfig.series"
```

## soc/arm/realtek_ameba/amebadplus/Kconfig.defconfig.amebadplus
```kconfig
# Copyright (c) 2024 Realtek Semiconductor Corp.
# SPDX-License-Identifier: Apache-2.0

if SOC_AMEBADPLUS

config SOC
	default "SOC_AMEBADPLUS"

config NUM_IRQS
	default 96

config AMEBADPLUS
	bool
	default y
	help
	  This option for code in modules/hal

config CACHE_MANAGEMENT
	default y

endif # SOC_AMEBADPLUS
```

## soc/arm/realtek_ameba/amebadplus/Kconfig.defconfig.series
```kconfig
# Copyright (c) 2024 Realtek Semiconductor Corp.
# SPDX-License-Identifier: Apache-2.0

if SOC_SERIES_AMEBADPLUS

config SOC_SERIES
        default "amebadplus"

config SYS_CLOCK_HW_CYCLES_PER_SEC
        default $(dt_node_int_prop_int,/clocks/clk_sys,clock-frequency)

rsource "Kconfig.defconfig.amebadplus"

endif #SOC_SERIES_AMEBADPLUS
```

## soc/arm/realtek_ameba/amebadplus/Kconfig.series
```kconfig
# Copyright (c) 2024 Realtek Semiconductor Corp.
# SPDX-License-Identifier: Apache-2.0

config SOC_SERIES_AMEBADPLUS
	bool "AmebaDplus Series MCU"
	select ARM
	select CPU_CORTEX_M33
	# select CPU_HAS_ARM_SAU
	# select CPU_HAS_FPU
	# select CPU_HAS_ARM_MPU
	select SOC_FAMILY_REALTEK_AMEBA
	# select ARM_TRUSTZONE_M
	# select SHARED_MULTI_HEAP
	# select SYSTICK_USE_EXTERNAL_CLOCK
	help
	    Enable support for AmebaDplus Series MCU
```

## soc/arm/realtek_ameba/amebadplus/Kconfig.soc
```kconfig
# Copyright (c) 2024 Realtek Semiconductor Corp.
# SPDX-License-Identifier: Apache-2.0

choice
	prompt "AmebaDplus MCU Selection"
	depends on SOC_SERIES_AMEBADPLUS

config SOC_AMEBADPLUS
	bool "Real-M300 on AmebaDplus"
	select CPU_CORTEX_M33
	select CPU_HAS_ARM_SAU

endchoice
```

## soc/arm/rtk_ameba/Kconfig
```kconfig
# Copyright (c) 2016 Open-RnD Sp. z o.o.
# SPDX-License-Identifier: Apache-2.0

config SOC_FAMILY_RTK_AMEBA
	bool
	select BUILD_OUTPUT_HEX

if SOC_FAMILY_RTK_AMEBA

config SOC_FAMILY
	string
	default "rtk_ameba"

rsource "*/Kconfig.soc"

endif # SOC_FAMILY_RTK_AMEBA
```

## soc/arm/rtk_ameba/amebadplus/Kconfig.defconfig.amebadplusx
```kconfig
if SOC_AMEBADPLUSX

config SOC
	default "SOC_AMEBADPLUSX"

config NUM_IRQS
	default 96

endif # SOC_AMEBADPLUSX
```

## soc/arm/rtk_ameba/amebadplus/Kconfig.soc
```kconfig
# Kconfig - Realtek AmebaDplus configuration options
#
# Copyright (c) 2018-2019 Realtek Semiconductor Corp.
#
# SPDX-License-Identifier: Apache-2.0
#
# Licensed under the Apache License, Version 2.0 (the "License");
# you may not use this file except in compliance with the License.
# You may obtain a copy of the License at
#
#     http://www.apache.org/licenses/LICENSE-2.0
#
# Unless required by applicable law or agreed to in writing, software
# distributed under the License is distributed on an "AS IS" BASIS,
# WITHOUT WARRANTIES OR CONDITIONS OF ANY KIND, either express or implied.
# See the License for the specific language governing permissions and
# limitations under the License.
#

choice
	prompt "AmebaDplus MUC Selection"
	depends on SOC_SERIES_AMEBADPLUS

config SOC_AMEBADPLUSX
	bool "KM4 on AMEBADPLUS"
	select CPU_CORTEX_M33
	select CPU_HAS_ARM_SAU

endchoice
```

## soc/realtek/ameba/amebadplus/Kconfig.defconfig.amebadplus
```kconfig
# Copyright (c) 2024 Realtek Semiconductor Corp.
# SPDX-License-Identifier: Apache-2.0

if SOC_AMEBADPLUS

config NUM_IRQS
	default 96

config AMEBADPLUS
	bool
	default y
	help
	  This option for code in modules/hal

endif # SOC_AMEBADPLUS
```

## soc/realtek/ameba/amebadplus/Kconfig.soc
```kconfig
# Copyright (c) 2024 Realtek Semiconductor Corp.
# SPDX-License-Identifier: Apache-2.0

config SOC_SERIES_AMEBADPLUS
	bool
	select SOC_FAMILY_AMEBA

config SOC_SERIES
	default "amebadplus" if SOC_SERIES_AMEBADPLUS

config SOC_AMEBADPLUS
	bool
	select SOC_SERIES_AMEBADPLUS

config SOC
	default "amebadplus" if SOC_AMEBADPLUS
```

## soc/realtek/ameba/amebapro2/Kconfig.soc
```kconfig
# Copyright (c) 2024 Realtek Semiconductor Corp.
# SPDX-License-Identifier: Apache-2.0

config SOC_AMEBAPRO2
	bool
	select SOC_FAMILY_REALTEK_AMEBA

config SOC
	default "amebapro2" if SOC_AMEBAPRO2
```
