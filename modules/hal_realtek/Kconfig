## modules/hal_realtek/Kconfig
```kconfig
# Copyright (c) 2026 Realtek Semiconductor Corp.
# SPDX-License-Identifier: Apache-2.0

config ZEPHYR_HAL_REALTEK_MODULE
	bool

config ZEPHYR_HAL_REALTEK_MODULE_BLOBS
	bool

config HAS_REALTEK_AMEBA
	bool

osource "$(ZEPHYR_HAL_REALTEK_MODULE_DIR)/Kconfig"
if HAS_REALTEK_AMEBA
rsource "ameba/Kconfig.ameba"
endif

rsource "bee/Kconfig.bee"
```

## modules/hal_realtek/ameba/at_cmd/Kconfig
```kconfig
# Copyright (c) 2026 Realtek Semiconductor Corp.
# SPDX-License-Identifier: Apache-2.0

menuconfig REALTEK_AMEBA_AT_SHELL
	bool "Realtek Ameba AT commands at the shell prompt"
	depends on SHELL
	depends on !SOC_SERIES_AMEBAD
	depends on HEAP_MEM_POOL_SIZE > 0
	select SHELL_RAW_LINE_HOOK
	help
	  Accept AT commands such as "AT+SEC=RSIP_EN,temp" at the shell
	  prompt. Lines starting with "AT+" go to the AT parser, other
	  lines are shell commands. Provides shell_raw_line_hook().

if REALTEK_AMEBA_AT_SHELL

config ATCMD_SECURE
	bool "AT+SEC: RSIP/Secure Boot/RDP/HUK OTP programming"
	default y
	help
	  AT+SEC: RSIP, Secure Boot, RDP and HUK keys and enables. Most
	  sub-commands are irreversible OTP writes.

endif # REALTEK_AMEBA_AT_SHELL
```

## samples/net/wifi/shell/boards/rtl8721f_evb.conf
```kconfig
# Copyright (c) 2026 Realtek Semiconductor Corp.
# SPDX-License-Identifier: Apache-2.0

# Realtek Ameba WiFi driver
CONFIG_WIFI_AMEBA=y
CONFIG_REALTEK_AMEBA_ZEPHYR_WIFI=y
CONFIG_WLAN=y
CONFIG_ETH_DRIVER=y
CONFIG_ETH_PHY_DRIVER=y
CONFIG_NET_L2_ETHERNET=y
CONFIG_NET_L2_WIFI_MGMT=y
CONFIG_NET_MGMT=y
CONFIG_NET_UDP=y
CONFIG_NET_UDP_CHECKSUM=y
CONFIG_WIFI_NM=y
CONFIG_WIFI_NM_MAX_MANAGED_INTERFACES=2
CONFIG_NET_IF_MAX_IPV4_COUNT=2
CONFIG_NET_SOCKETS=y
CONFIG_NET_SOCKETS_SERVICE_THREAD_PRIO=-3
CONFIG_ZVFS_POLL_MAX=32
CONFIG_DYNAMIC_INTERRUPTS=y
CONFIG_FLASH=y
CONFIG_HEAP_MEM_POOL_SIZE=65536

# Required by NET_L2_WIFI_SHELL on Ameba
CONFIG_NEWLIB_LIBC=y

# Persistent WiFi credentials via settings/ZMS backend
CONFIG_SETTINGS=y
CONFIG_ZMS=y
CONFIG_ZMS_LOOKUP_CACHE=y
CONFIG_ZMS_LOOKUP_CACHE_SIZE=512
CONFIG_FLASH_MAP=y
CONFIG_WIFI_CREDENTIALS=y
CONFIG_WIFI_CREDENTIALS_BACKEND_SETTINGS=y

# AP mode DHCP server support
CONFIG_NET_DHCPV4_SERVER=y
CONFIG_NET_DHCPV4_SERVER_ADDR_COUNT=10
CONFIG_NET_MAX_CONN=10
CONFIG_ZVFS_OPEN_MAX=6
CONFIG_NET_DHCPV4_INIT_REBOOT=n
```

## samples/subsys/mgmt/mcumgr/smp_svr/boards/rtl8730e_evb.conf
```kconfig
#
# Copyright (c) 2026 Realtek Semiconductor Corp.
#
# SPDX-License-Identifier: Apache-2.0
#

CONFIG_SMP=n
CONFIG_UART_MCUMGR=y
CONFIG_MCUMGR_TRANSPORT_UART=y
CONFIG_UART_MCUMGR_RX_BUF_SIZE=1024
CONFIG_MCUMGR_TRANSPORT_UART_MTU=1024
CONFIG_MCUMGR_TRANSPORT_NETBUF_SIZE=1024
CONFIG_BASE64=y
CONFIG_CRC=y

CONFIG_IMG_ERASE_PROGRESSIVELY=y
CONFIG_HEAP_MEM_POOL_SIZE=65536

CONFIG_MCUBOOT_IMGTOOL_SIGN_VERSION="0.0.0+0"
CONFIG_MCUBOOT_EXTRA_IMGTOOL_ARGS="--security-counter 0"
```

## soc/realtek/ameba/amebasmart/Kconfig
```kconfig
# Copyright (c) 2026 Realtek Semiconductor Corp.
# SPDX-License-Identifier: Apache-2.0

config SOC_RTL8730E_CA32
	select ARM
	select CPU_CORTEX_A32
	select ARM_ARCH_TIMER
	select CPU_HAS_FPU
	select FPU
	select HAS_PM

# KM4 — MCUboot bootloader domain
config SOC_RTL8730E_KM4
	select ARM
	select CPU_CORTEX_M55
	select ARMV8_M_DSP
	select CPU_HAS_ARM_MPU
	select ARM_MPU
	select CPU_HAS_ARM_SAU
	select CPU_HAS_FPU
	select CPU_HAS_VFP
	select DYNAMIC_INTERRUPTS
```

## soc/realtek/ameba/amebasmart/Kconfig.soc
```kconfig
# Copyright (c) 2026 Realtek Semiconductor Corp.
# SPDX-License-Identifier: Apache-2.0

config SOC_SERIES_AMEBASMART
	bool
	select SOC_FAMILY_REALTEK_AMEBA
	select CPU_HAS_DCACHE
	select CPU_HAS_ICACHE

config SOC_SERIES
	default "amebasmart" if SOC_SERIES_AMEBASMART

config SOC_RTL8730E
	bool
	select SOC_SERIES_AMEBASMART
	select CPU_HAS_NEON
	select VFP_DP_D32_FP16_FMAC

config SOC
	default "rtl8730e" if SOC_RTL8730E
```

## tests/drivers/adc/adc_api/boards/rtl8730e_evb.conf
```kconfig
#
# Copyright (c) 2026 Realtek Semiconductor Corp.
#
# SPDX-License-Identifier: Apache-2.0
#

CONFIG_ADC_ASYNC=n
CONFIG_TEST_USERSPACE=n
```

## tests/drivers/dma/loop_transfer/boards/rtl8730e_evb.conf
```kconfig
#
# Copyright (c) 2026 Realtek Semiconductor Corp.
#
# SPDX-License-Identifier: Apache-2.0
#

CONFIG_DMA_LOOP_TRANSFER_CHANNEL_NR=0
CONFIG_DMA_LOOP_TRANSFER_SIZE=4096
CONFIG_NOCACHE_MEMORY=y
```

## tests/drivers/flash/common/boards/rtl872xda_evb.conf
```kconfig
#
# Copyright (c) 2026 Realtek Semiconductor Corp.
#
# SPDX-License-Identifier: Apache-2.0
#

CONFIG_FLASH_MAP=y
```

## tests/drivers/spi/spi_loopback/boards/rtl872xda_evb.conf
```kconfig
CONFIG_GPIO=y
CONFIG_SPI_AMEBA_DMA=y
CONFIG_SPI_IDEAL_TRANSFER_DURATION_SCALING=100
# CONFIG_SPI_LOOPBACK_MODE_LOOP=n
# CONFIG_SPI_AMEBA_INTERRUPT=y
# CONFIG_SPI_AMEBA_POLLING=y
```
