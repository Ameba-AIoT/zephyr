## soc/realtek/ameba/common/Kconfig.mcuboot
```kconfig
# Copyright (c) 2025 Realtek Semiconductor Corp.
# SPDX-License-Identifier: Apache-2.0

AMEBA_RSIP_IV_TYPE_IN_TLV := 0x00A1

config AMEBA_USING_MANIFEST_KEY
	bool "Using key generated from manifest"
	depends on !BOOT_SIGNATURE_TYPE_NONE
	help
		Use key from manifest to signature image for mcuboot

config AMEBA_RSIP_IV_TYPE_IN_TLV
	hex "Rsip iv type enum value in tlv"
	default $(AMEBA_RSIP_IV_TYPE_IN_TLV)
```

## soc/realtek/ameba/common/Kconfig.psram
```kconfig
# Copyright (c) 2025 Realtek Semiconductor Corp.
# SPDX-License-Identifier: Apache-2.0

config AMEBA_PSRAM
	def_bool y if $(dt_nodelabel_enabled,psram)

config AMEBA_PSRAM_HEAP_SIZE
	int "Size of PSRAM heap"
	depends on AMEBA_PSRAM
	default 262134 if SYS_HEAP_SMALL_ONLY
	default 1048576 if !SYS_HEAP_SMALL_ONLY
	help
		Specify size of PSRAM heap.

config AMEBA_PSRAM_SIZE
	hex
	depends on AMEBA_PSRAM
	default $(dt_nodelabel_reg_size_hex,psram)

choice
	prompt "PSRAM Heap Allocate type"
	depends on AMEBA_PSRAM
	default PSRAM_HEAP_NONE
	config PSRAM_HEAP_SHARED_MULTI
		bool "SHARED MULTI HEAP"
		select SHARED_MULTI_HEAP
	config PSRAM_HEAP_SINGLE
		bool "PSRAM HEAP SINGLE"
	config PSRAM_HEAP_NONE
		bool "PSRAM HEAP NONE"
endchoice
```

## soc/xtensa/stark_hifi4_upg1409/Kconfig.defconfig
```kconfig
# XTENSA board configuration

# Copyright (c) 2016 Open-RnD Sp. z o.o.
# Copyright (c) 2016 Cadence Design Systems, Inc.
# SPDX-License-Identifier: Apache-2.0

if SOC_STARK_HIFI4_UPG1409

config SOC
	default "stark_hifi4_upg1409"

config SOC_TOOLCHAIN_NAME
	string
	default "stark_hifi4_upg1409"

endif
```

## soc/xtensa/stark_hifi4_upg1409/Kconfig.soc
```kconfig
# Copyright (c) 2017 Intel Corporation
# SPDX-License-Identifier: Apache-2.0

config SOC_STARK_HIFI4_UPG1409
	bool "Xtensa STARK_HIFI4_UPG1409 core"
	select XTENSA
	select XTENSA_HAL
	select ARCH_SUPPORTS_COREDUMP
```

## tests/drivers/can/api/boards/rtl8721f_evb.conf
```kconfig
#
# Copyright (c) 2025 Realtek Semiconductor Corp.
#
# SPDX-License-Identifier: Apache-2.0
#

CONFIG_TEST_USERSPACE=n
CONFIG_HEAP_MEM_POOL_SIZE=65536
```

## tests/drivers/can/timing/boards/rtl8721f_evb.conf
```kconfig
#
# Copyright (c) 2025 Realtek Semiconductor Corp.
#
# SPDX-License-Identifier: Apache-2.0
#

CONFIG_TEST_ALL_BITRATES=y
CONFIG_HEAP_MEM_POOL_SIZE=65536
```

## tests/drivers/display/display_read_write/boards/rtl8721f_evb.conf
```kconfig
# Copyright (c) 2024 Renesas Electronics Corporation
# SPDX-License-Identifier: Apache-2.0

# CONFIG_AMEBA_LCDC_ARGB8888=y
CONFIG_AMEBA_LCDC_RGB565=y
# CONFIG_AMEBA_LCDC_FB_NUM=2
```

## tests/drivers/dma/chan_blen_transfer/boards/rtl872xd_evb.conf
```kconfig
#
# Copyright (c) 2025 Realtek Semiconductor Corp.
#
# SPDX-License-Identifier: Apache-2.0
#

CONFIG_DMA_TRANSFER_CHANNEL_NR_0=3
CONFIG_DMA_TRANSFER_CHANNEL_NR_1=2
```

## tests/drivers/dma/chan_link_transfer/boards/rtl872xda_evb.conf
```kconfig
#
# Copyright (c) 2024 Realtek Semiconductor Corp.
#
# SPDX-License-Identifier: Apache-2.0
#

CONFIG_HEAP_MEM_POOL_SIZE=65536
```

## tests/drivers/dma/loop_transfer/boards/rtl872xd_evb.conf
```kconfig
#
# Copyright (c) 2025 Realtek Semiconductor Corp.
#
# SPDX-License-Identifier: Apache-2.0
#

CONFIG_DMA_LOOP_TRANSFER_CHANNEL_NR=1
CONFIG_DMA_LOOP_TRANSFER_SIZE=2048
```

## tests/drivers/flash/common/boards/rtl872xd_evb.conf
```kconfig
# Copyright (c) 2024 Realtek Semiconductor Corp.
# SPDX-License-Identifier: Apache-2.0

CONFIG_FLASH=y
CONFIG_FLASH_MAP=y
```

## tests/drivers/i2s/i2s_api/boards/rtl8721f_evb.conf
```kconfig
#
# Copyright (c) 2025 Realtek Semiconductor Corp.
#
# SPDX-License-Identifier: Apache-2.0
#

CONFIG_I2S_TEST_ALLOWED_DATA_OFFSET=2
```

## tests/drivers/spi/spi_loopback/boards/rtl8721f_evb.conf
```kconfig
CONFIG_GPIO=y
CONFIG_SPI_AMEBA_POLLING=y
# CONFIG_SPI_ASYNC=y
# CONFIG_SPI_AMEBA_INTERRUPT=y
# CONFIG_SPI_AMEBA_DMA=y
```
