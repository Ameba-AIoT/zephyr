## drivers/gpio/Kconfig.amebapro2
```kconfig
# Copyright (c) 2024 Realtek Semiconductor Corp.
# SPDX-License-Identifier: Apache-2.0

menuconfig GPIO_AMEBAPRO2
	bool "GPIO controller driver for Realtek Ameba series SoC"
	default y
	depends on DT_HAS_REALTEK_AMEBAPRO2_GPIO_ENABLED
	help
	  Enable GPIO controller driver for Realtek Ameba series SoC

config GPIO_DEBOUNCE_EN
	bool "Ameba GPIO Interrupt Debounce Enable"
	depends on GPIO_AMEBAPRO2
	default y
	help
	  When Enable GPIO Interrupt Debounce, the external signal can be debounced to
	  remove any spurious glitches that are less than one period(about 32us) of
	  the external debouncing clock.
```

## drivers/i2c/Kconfig.ameba
```kconfig
# AMEBA I2C configuration options

# Copyright (c) 2024 Realtek Semiconductor Corp.
# SPDX-License-Identifier: Apache-2.0

config I2C_AMEBA
	bool "AMEBA I2C driver"
	default y
	depends on DT_HAS_REALTEK_AMEBA_I2C_ENABLED
	help
	  Enables the AMEBA I2C driver

config I2C_AMEBA_INTERRUPT
	bool "Ameba I2C Interrupt Support"
	depends on I2C_AMEBA
	default y
	help
	  Enable Interrupt support for the I2C Driver
```

## drivers/i2c/Kconfig.amebapro2
```kconfig
# AMEBAPRO2 I2C configuration options

# Copyright (c) 2024 Realtek Semiconductor Corp.
# SPDX-License-Identifier: Apache-2.0

menuconfig I2C_AMEBAPRO2
	bool "AMEBAPRO2 I2C driver"
	default y
	depends on DT_HAS_REALTEK_AMEBAPRO2_I2C_ENABLED
	select PINCTRL
	# the ASYNC implementation requires a DMA controller
	help
	  Enables the AMEBA I2C driver
config I2C_AMEBA_INTERRUPT
	bool "Ameba I2C Interrupt Support"
	depends on I2C_AMEBAPRO2
	default y
	help
	  Enable Interrupt support for the I2C Driver
```

## drivers/i2s/Kconfig.ameba
```kconfig
# AMEBA I2S driver configuration options

# Copyright (c) 2024 Realtek Semiconductor Corp.
# SPDX-License-Identifier: Apache-2.0

menuconfig I2S_AMEBA
	bool "AMEBA MCU I2S controller driver"
	default y
	depends on DT_HAS_REALTEK_AMEBA_I2S_ENABLED
	# select DMA
	help
	  Enable I2S support on the AMEBA family of processors.

if I2S_AMEBA

config I2S_RX_BLOCK_COUNT
	int "RX queue length"
	default 4  # 1 enough  todo:4

config I2S_TX_BLOCK_COUNT
	int "TX queue length"
	default 4  # 1 enough  todo:4

endif # I2S_AMEBA
```

## drivers/mdio/Kconfig.ameba
```kconfig
# Copyright (c) 2025 Realtek Semiconductor Corp.
# SPDX-License-Identifier: Apache-2.0

config MDIO_AMEBA
	bool "AMEBA MDIO driver"
	default y
	depends on DT_HAS_REALTEK_AMEBA_MDIO_ENABLED
	help
	  Enable AMEBA MCU Family MDIO driver.

if MDIO_AMEBA

choice ETH_AMEBA_CLK_DIRECTION
	prompt "Ameba Phy Clock Source"
	default ETH_AMEBA_MAC_TO_PHY_50M

config ETH_AMEBA_MAC_TO_PHY_50M
	bool "MAC TO PHY 50MHZ"

config ETH_AMEBA_MAC_TO_PHY_25M
	bool "MAC TO PHY 25MHZ"


config ETH_AMEBA_PHY_INTERNAL_XTAL
	bool "PHY INTERNAL XTAL"

endchoice

endif
```

## drivers/mipi_dbi/Kconfig.ameba
```kconfig
# Copyright (c) 2025 Realtek Semiconductor Corp.
# SPDX-License-Identifier: Apache-2.0

config MIPI_DBI_LCDC_AMEBA
	bool "AMEBA MIPI DBI LCDC driver"
	default y
	depends on DT_HAS_REALTEK_AMEBA_LCDC_ENABLED
	depends on CLOCK_CONTROL
	select PINCTRL
	help
	  Enable support for AMEBA LCDC display controller driver

if MIPI_DBI_LCDC_AMEBA

# config MIPI_DBI_LCDC_AMEBA_DMA
# 	bool "Use DMA for transfers with LCDC driver"
# 	select DMA
# 	help
# 	  Use DMA for transfers when sending data with the LCDC_AMEBA driver.
# 	  Commands will still be sent in polling mode.

endif # MIPI_DBI_LCDC_AMEBA
```

## drivers/mipi_dbi/Kconfig.ameba_lcdc
```kconfig
# Copyright (c) 2025 Realtek Semiconductor Corp.
# SPDX-License-Identifier: Apache-2.0

config MIPI_DBI_AMEBA_LCDC
	bool "MIPI DBI AMEBA LCDC driver"
	default y
	depends on DT_HAS_REALTEK_MIPI_DBI_AMEBA_LCDC_ENABLED
	# depends on CLOCK_CONTROL
	select PINCTRL
	help
	  Enable support for MIPI DBI SPI driver.
	  This driver implements a MIPI-DBI type B using LCDC display controller driver.


choice AMEBA_LCDC_PIXEL_FORMAT
	prompt "Color pixel format(input)"
	# default AMEBA_LCDC_RGB888
	default AMEBA_LCDC_RGB565
	depends on MIPI_DBI_AMEBA_LCDC
	help
	  Specify the color pixel format for the AMEBA LCD-TFT display controller.

	config AMEBA_LCDC_ARGB8888
		bool "ARGB8888"
		help
		  One pixel consists of 8-bit alpha, 8-bit red, 8-bit green and 8-bit blue value
		  (4 bytes per pixel)
	config AMEBA_LCDC_RGB888
		bool "RGB888"
		help
		  One pixel consists of 8-bit red, 8-bit green and 8-bit blue value
		  (3 bytes per pixel)
	config AMEBA_LCDC_RGB565
		bool "RGB565"
		help
		  One pixel consists of 5-bit red, 6-bit green and 5-bit blue value
		  (2 bytes per pixel)
	config AMEBA_LCDC_BGR565
		bool "BGR565"
		help
		  One pixel consists of 5-bit blue, 6-bit green and 5-bit red value
		  (2 bytes per pixel)
endchoice

choice MIPI_DBI_AMEBA_LCDC_MODE_SELECT
	prompt "Work mode"
	default AMEBA_LCDC_VSYNC_ENABLE
	depends on MIPI_DBI_AMEBA_LCDC
	help
	  Specify the work mode in MIPI-DBI for LCDC controller.

	config AMEBA_LCDC_TE_ENABLE
		bool "Tear Effect"
		help
		  Work in MCU TE mode
	config AMEBA_LCDC_IO_ENABLE
		bool "IO"
		help
		  Work in MCU IO mode
	config AMEBA_LCDC_VSYNC_ENABLE
		bool "VSYNC"
		help
		  Work in MCU VSYNC trigger mode
endchoice
```

## drivers/misc/ameba_mjpeg/Kconfig
```kconfig
# Copyright (c) 2024 Realtek Semiconductor Corp.
# SPDX-License-Identifier: Apache-2.0

config AMEBA_MJPEG
	bool "AMEBA Motion Joint Photographic Experts Group"
	default n
	depends on DT_HAS_REALTEK_AMEBA_MJPEG_ENABLED
	help
	  Enables the Realtek Ameba Motion Joint Photographic Experts Group driver.

if AMEBA_MJPEG

config AMEBA_MJPEG_INIT_PRIORITY
	int "AMEBA Motion Joint Photographic Experts Group driver init priority"
	default KERNEL_INIT_PRIORITY_DEVICE
	help
	  Ameba Motion Joint Photographic Experts Group driver initialization priority.

module = AMEBA_MJPEG
module-str = ameba_mjpeg
source "subsys/logging/Kconfig.template.log_config"

endif # AMEBA_MJPEG
```

## drivers/misc/ameba_ppe/Kconfig
```kconfig
# Copyright (c) 2024 Realtek Semiconductor Corp.
# SPDX-License-Identifier: Apache-2.0

config AMEBA_PPE
	bool "AMEBA Pixel Processing Engine"
	default n
	depends on DT_HAS_REALTEK_AMEBA_PPE_ENABLED
	help
	  Enables the Realtek Ameba Pixel Processing Engine driver.

if AMEBA_PPE

config AMEBA_PPE_INIT_PRIORITY
	int "AMEBA Pixel Processing Engine driver init priority"
	default KERNEL_INIT_PRIORITY_DEVICE
	help
	  Ameba Pixel Processing Engine driver driver initialization priority.

module = AMEBA_PPE
module-str = ameba_ppe
source "subsys/logging/Kconfig.template.log_config"

endif # AMEBA_PPE
```

## drivers/pinctrl/Kconfig.ameba
```kconfig
# Copyright (c) 2024 Realtek Semiconductor Corp.
# SPDX-License-Identifier: Apache-2.0

config PINCTRL_REALTEK
	bool "Pin controller driver for Realtek"
	default y
	depends on DT_HAS_REALTEK_AMEBADPLUS_PINCTRL_ENABLED
	help
	  Enable pin controller driver for Realtek
```

## drivers/pinctrl/Kconfig.amebapro2
```kconfig
# Copyright (c) 2024 Realtek Semiconductor Corp.
# SPDX-License-Identifier: Apache-2.0

config PINCTRL_AMEBAPRO2
	bool "Pin controller driver for Realtek AmebaPro2 SoC"
	default y
	depends on DT_HAS_REALTEK_AMEBAPRO2_PINCTRL_ENABLED
	help
	  Enable pin controller driver for Realtek AmebaPro2 SoC
```

## drivers/sdhc/Kconfig.ameba
```kconfig
# Copyright (c) 2024 Realtek Semiconductor Corp.
# SPDX-License-Identifier: Apache-2.0

config SDHC_AMEBA
	bool "AMEBA SD Host Controller"
	default y
	depends on DT_HAS_REALTEK_AMEBA_SDHC_ENABLED
	select PINCTRL
	help
	  Enables the Realtek Ameba SD Host controller driver
```

## drivers/sensor/realtek/Kconfig
```kconfig
# Copyright (c) 2024 Analog Devices, Inc.
# SPDX-License-Identifier: Apache-2.0

# zephyr-keep-sorted-start
source "drivers/sensor/realtek/ameba_temp/Kconfig"
# zephyr-keep-sorted-stop
```

## drivers/serial/Kconfig.amebapro2_loguart
```kconfig
# Copyright (c) 2024 Realtek Semiconductor Corp.
# SPDX-License-Identifier: Apache-2.0

config UART_AMEBAPRO2_LOGUART
	bool "AmebaPro2 LOGUART driver"
	default y
	depends on DT_HAS_REALTEK_AMEBAPRO2_LOGUART_ENABLED
	select SERIAL_HAS_DRIVER
	select SERIAL_SUPPORT_INTERRUPT
	help
	  This option enables the LOGUART driver for Realtek Ameba SoCs.
```

## drivers/spi/Kconfig.ameba
```kconfig
# AMEBA SPI configuration

# Copyright (c) 2024 Realtek Semiconductor Corp.
# SPDX-License-Identifier: Apache-2.0

menuconfig SPI_AMEBA
	bool "AMEBA SPI driver"
	default y
	depends on DT_HAS_REALTEK_AMEBA_SPI_ENABLED
	help
		Enables support for AMEBA SPI driver.

if SPI_AMEBA

config SPI_AMEBA_INTERRUPT
	bool "AMEBA SPI interrupt mode"
	help
		Enables interrupt support for AMEBA SPI driver.

endif # SPI_AMEBA
```

## drivers/spi/Kconfig.amebapro2
```kconfig
# AMEBA SPI configuration

# Copyright (c) 2024 Realtek Semiconductor Corp.
# SPDX-License-Identifier: Apache-2.0

menuconfig SPI_AMEBAPRO2
	bool "AmebaPro2 SPI driver"
	default y
	depends on DT_HAS_REALTEK_AMEBAPRO2_SPI_ENABLED
	select PINCTRL
	select SPI_AMEBAPRO2_DMA
	help
		Enables support for AMEBA SPI driver.
```

## drivers/video/Kconfig.amebapro2
```kconfig
# AmebaPro2 video driver configuration options

# Copyright (c) 2024 Realtek Semiconductor Corp.
# SPDX-License-Identifier: Apache-2.0

config VIDEO_AMEBAPRO2
	bool "Realtek AmebaPro2 Video Driver"
	depends on VIDEO && DT_HAS_REALTEK_AMEBAPRO2_VIDEO_ENABLED
	default y
	help
		Enable support for the Realtek AmebaPro2 video driver.
```

## dts/bindings/audio/realtek,ameba-dmic.yaml
```yaml
# Copyright (c) 2024 Realtek Semiconductor Corp.
# SPDX-License-Identifier: Apache-2.0

description: AMEBA digital PDM microphone family

compatible: "realtek,ameba-dmic"

include: i2s-device.yaml
```

## dts/bindings/audio/realtek,amebapro2-dmic.yaml
```yaml
# Copyright (c) 2024 Realtek Semiconductor Corp.
# SPDX-License-Identifier: Apache-2.0

description: |
  AMEBAPRO2 digital PDM microphone (DMIC) codec with integrated SPORT peripheral.

compatible: "realtek,amebapro2-dmic"

include: [base.yaml]

properties:
  reg:
    required: true
```

## dts/bindings/counter/realtek,ameba-counter.yaml
```yaml
# Copyright (c) 2024 Realtek Semiconductor Corp.
# SPDX-License-Identifier: Apache-2.0

description: Ameba counters

compatible: "realtek,ameba-counter"

include: base.yaml

properties:
  reg:
    required: true

  interrupts:
    required: false

  freq:
    type: int
    enum:
      - 32768
      - 1000000
    description: freq of basic timer clk source
```

## dts/bindings/disk/realtek,sdmmc.yaml
```yaml
# Copyright (c) 2024 Realtek Semiconductor Corp.
# SPDX-License-Identifier: Apache-2.0

description: Amebapro2 SDMMC

compatible: "realtek,amebapro2-sdmmc"

include: [base.yaml]

properties:
  reg:
    required: true

  interrupts:
    required: true
```

## dts/bindings/display/ilitek,ili9806.yaml
```yaml
# Copyright (c) 2025 Realtek Semiconductor Corp.
# SPDX-License-Identifier: Apache-2.0

description: ILI9806 480RGBx800 display controller

compatible: "ilitek,ili9806"

include: ilitek,ili9xxx-common.yaml

properties:
  extccmdset:
    type: uint8-array
    default: [0xFF, 0x98, 0x06]
    description:
      EXTC command enable (EXTC Command Set enable) register value.

  gip1:
    type: uint8-array
    default: [
      0x01,
      0x0F,
      0x61,
      0xFF,
      0x01,
      0x01,
      0x0B,
      0x10,
      0x37,
      0x63,
      0xFF,
      0xFF,
      0x01,
      0x01,
      0x00,
      0x00,
      0xFF,
      0x52,
      0x01,
      0x00,
      0x40
    ]
    description:
      GIP1 (Gate In Panel 1) register value.

  gip2:
    type: uint8-array
    default: [0x01, 0x23, 0x45, 0x67, 0x01, 0x23, 0x45, 0x67]
    description:
      GIP2 (Gate In Panel 2) register value.

  gip3:
    type: uint8-array
    default: [0x00, 0x01, 0xAB, 0x60, 0x22, 0x22, 0x22, 0x22, 0x22]
    description:
      GIP3 (Gate In Panel 3) register value.

  vcomcontrol:
    type: uint8-array
    default: [0x36]
    description:
      VCOM control register value.

  envolreg:
    type: uint8-array
    default: [0x7F, 0x0F]
    description:
      Environmental voltage register value.

  pwctrl1:
    type: uint8-array
    default: [0x0F, 0x0B, 0x0A]
    description:
      Power control 1 register value.

  avdd:
    type: uint8-array
    default: [0x08]
    description:
      AVDD register value.

  engineerset:
    type: uint8-array
    default: [0x00, 0x00, 0x00, 0x00, 0x00, 0x20]
    description:
      Engineer set register value.

  dvdd:
    type: uint8-array
    default: [0x74]
    description:
      DVDD register value.

  invesiontype:
    type: uint8-array
    default: [0x00, 0x00, 0x00]
    description:
      Inversion type register value.

  resolutionctrl:
    type: uint8-array
    default: [0x82]
    description:
      Resolution control register value.

  frameratectrl:
    type: uint8-array
    default: [0x00, 0x13, 0x13]
    description:
      Frame rate control register value.

  creqpcsdt:
    type: uint8-array
    default: [0x80, 0x04, 0x40, 0x28]
    description:
      Creq PCS DT register value.

  pwctrl2:
    type: uint8-array
    default: [0x17, 0x88, 0x88, 0x20]
    description:
      Power control 2 register value.

  pgamctrl:
    type: uint8-array
    default: [
        0x00,
        0x0A,
        0x12,
        0x10,
        0x0E,
        0x20,
        0xCC,
        0x07,
        0x06,
        0x0B,
        0x0E,
        0x0F,
        0x0D,
        0x15,
        0x10,
        0x00
    ]
    description:
      Positive gamma control register value.

  ngamctrl:
    type: uint8-array
    default: [
        0x00,
        0x0B,
        0x13,
        0x0D,
        0x0E,
        0x1B,
        0x71,
        0x06,
        0x06,
        0x0A,
        0x0F,
        0x0E,
        0x0F,
        0x15,
        0x0C,
        0x00
    ]
    description:
      Negative gamma control register value.

  caddrset:
    type: uint8-array
    default: [0x00, 0x00, 0x01, 0xdf]
    description:
      CMN column address set register value.

  paddrset:
    type: uint8-array
    default: [0x00, 0x00, 0x03, 0x1f]
    description:
      CMN page address set register value.

  # use definations in ilitek,ili9xxx-common.yaml
  pixformat:
    type: uint8-array
    default: [0x77]
    description:
      Pixel format register value.
      16bpp, rgb565; 24bpp, rgb888

  memaccessctrl:
    type: uint8-array
    default: [0x00]
    description:
      Memory access control register value.

  slpout:
    type: uint8-array
    description:
      CMN sleep out register value.

  displaypon:
    type: uint8-array
    description:
      CMN display on register value.

  memwrite:
    type: uint8-array
    description:
      CMN memory write register value.
```

## dts/bindings/display/realtek,ameba-lcdc.yaml
```yaml
# Copyright (c) 2025 Realtek Semiconductor Corp.
# SPDX-License-Identifier: Apache-2.0

description: Ameba LCDC Display Controller.
compatible: "realtek,ameba-lcdc"

include: [lcd-controller.yaml, pinctrl-device.yaml]

properties:
  interrupts:
    required: true

  clocks:
    required: true

  data-bus-width:
    type: string
    required: true
    enum:
      - "6-bit"
      - "8-bit"
      - "16-bit"
      - "24-bit"
    description:
      LCD data bus width. The default is set to the reset value of 24-bit.

  frame-rate:
    type: int
    required: true
    description: |
      The LCD controller transmits the frame rate to the LCD.

  backlight-gpios:
    type: phandle-array
    required: true
    description:
      Backlight on/off GPIO pin. It's required true for blanking on/off reason.
      Configure the GPIO polarity (active high/active low) according to LCD datasheet.

  display-gpios:
    type: phandle-array
    # required: true
    description:
      Display on/off GPIO pin.
      Configure the GPIO polarity (active high/active low) according to LCD datasheet.
```
