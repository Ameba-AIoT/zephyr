## boards/realtek/pke8721daf_c13_f10/Kconfig.defconfig
```kconfig
# Copyright (c) 2026 Realtek Semiconductor Corp.
# SPDX-License-Identifier: Apache-2.0

# Configurations here work for all pke8721daf_c13_f10 variants(like mcuboot)

ZEPHYR_USER := zephyr,user

config RUNTIME_NMI
	default y

config CORTEX_M_SYSTICK
	default y

# Enable hardware stack protection
config HW_STACK_PROTECTION
	default y

# enable rcc
config CLOCK_CONTROL
	default y

# enable uart
config SERIAL
	default y

# enable console for stdout
config CONSOLE
	default y

config UART_CONSOLE
	default y

# enable GPIO
config GPIO
	default y

config NOCACHE_MEMORY
	default y

if PM

choice PM_POLICY
	default PM_POLICY_CUSTOM
endchoice

config PM_S2RAM
	default y
	select PM_S2RAM_CUSTOM_MARKING

endif # PM

if BOOTLOADER_MCUBOOT

config FLASH_BASE_ADDRESS
	hex
	default $(dt_node_int_prop_hex,/$(ZEPHYR_USER),primary-logic-base)

endif

config BUILD_WITH_TFM
	default y if TRUSTED_EXECUTION_NONSECURE

if TFM_BL2

config FLASH_BASE_ADDRESS
	hex
	default $(dt_node_int_prop_hex,/$(ZEPHYR_USER),primary-logic-addr)

endif
```

## boards/realtek/rtl8721f_evb/Kconfig.defconfig
```kconfig
# Copyright (c) 2025 Realtek Semiconductor Corp.
# SPDX-License-Identifier: Apache-2.0

# Configurations here work for all rtl8721f_evb variants(like mcuboot)

ZEPHYR_USER := zephyr,user

config RUNTIME_NMI
	default y

config CORTEX_M_SYSTICK
	default y

# Enable hardware stack protection
config HW_STACK_PROTECTION
	default y

# enable rcc
config CLOCK_CONTROL
	default y

# enable uart
config SERIAL
	default y

# enable console for stdout
config CONSOLE
	default y

config UART_CONSOLE
	default y

# enable GPIO
config GPIO
	default y

config NOCACHE_MEMORY
	default y

if PM

choice PM_POLICY
	default PM_POLICY_CUSTOM
endchoice

config PM_S2RAM
	default y
	select PM_S2RAM_CUSTOM_MARKING
	select HAS_PM_S2RAM_CUSTOM_MARKING

endif # PM

if MCUBOOT

config LOG_OVERRIDE_LEVEL
	default 4

endif

if BOOTLOADER_MCUBOOT

config FLASH_BASE_ADDRESS
	hex
	default $(dt_node_int_prop_hex,/$(ZEPHYR_USER),primary-logic-base)

endif

config BUILD_WITH_TFM
	default y if TRUSTED_EXECUTION_NONSECURE

if TFM_BL2

config FLASH_BASE_ADDRESS
	hex
	default $(dt_node_int_prop_hex,/$(ZEPHYR_USER),primary-logic-addr)

endif

if BOARD_RTL8721F_EVB_RTL8721F_MCUBOOT && !MCUBOOT

config BOOTLOADER_MCUBOOT
	default y

endif
```

## boards/realtek/rtl872xda_evb/Kconfig.sysbuild
```kconfig
# Copyright (c) 2026 Realtek Semiconductor Corp.
# SPDX-License-Identifier: Apache-2.0

choice BOOTLOADER
	default BOOTLOADER_MCUBOOT if BOARD_RTL872XDA_EVB_RTL8721DX_MCUBOOT
endchoice
```

## boards/realtek/rtl872xda_evb/board.yml
```yaml
board:
  name: rtl872xda_evb
  vendor: realtek
  socs:
    - name: rtl8721dx
      variants:
        - name: mcuboot
        - name: ns
```

## boards/realtek/rtl8730e_evb/rtl8730e_evb_mcuboot_defconfig
```kconfig
# Copyright (c) 2026 Realtek Semiconductor Corp.
# SPDX-License-Identifier: Apache-2.0

CONFIG_XIP=n
CONFIG_MCUBOOT_ACTION_HOOKS=y
CONFIG_MINIMAL_LIBC=y
CONFIG_MAIN_STACK_SIZE=8192
CONFIG_MBEDTLS_PSA_KEY_SLOT_COUNT=4
```

## drivers/can/Kconfig.ameba
```kconfig
# Copyright (c) 2025 Realtek Semiconductor Corp.
# SPDX-License-Identifier: Apache-2.0

# Realtek AMEBA CAN configuration options
config CAN_AMEBA_CAN
	bool "Realtek CAN driver"
	default y
	depends on DT_HAS_REALTEK_AMEBA_CAN_ENABLED
	select CAN_SJA1000
	select PINCTRL
	help
	  This enables support for the Realtek Controller Area Network  (CAN)
	  driver.
```

## drivers/display/Kconfig.gh7002
```kconfig
# Copyright (c) 2026 Realtek Semiconductor Corp.
# SPDX-License-Identifier: Apache-2.0

config GH7002
	bool "GH7002 MIPI-DSI panel"
	default y
	depends on DT_HAS_REALTEK_GH7002_ENABLED
	select MIPI_DSI
	help
	  Enable driver for the GH7002 1024x600 MIPI-DSI panel (Driver IC:
	  gh7002-01, Screen: hj7001-02). The init sequence and timings are tuned
	  for the 2-lane RGB888 module on the AmebaSmart (RTL8730E) board.
```

## drivers/display/Kconfig.st7701s
```kconfig
# Copyright (c) 2026 Realtek Semiconductor Corp.
# SPDX-License-Identifier: Apache-2.0

config ST7701S
	bool "Sitronix ST7701S MIPI-DSI panel"
	default y
	depends on DT_HAS_SITRONIX_ST7701S_ENABLED
	select MIPI_DSI
	help
	  Enable driver for the Sitronix ST7701S MIPI-DSI panel.  The active
	  resolution is taken from the devicetree width/height properties.
	  The init sequence is tuned for the target 480x800 panel module.

	  The panel initialises at CONFIG_APPLICATION_INIT_PRIORITY, after both
	  the MIPI-DSI host and the LCDC controller, so mipi_dsi_attach() finds a
	  ready host and the host switches the link to video once the panel has
	  issued its display-on.
```

## drivers/hwinfo/Kconfig.ameba
```kconfig
# Copyright (c) 2024 Realtek Semiconductor Corp.
# SPDX-License-Identifier: Apache-2.0

config HWINFO_AMEBA
	bool "AMEBA hwinfo"
	default y
	depends on SOC_FAMILY_REALTEK_AMEBA
	select HWINFO_HAS_DRIVER
	help
	  Enable Ameba hwinfo driver.
```

## drivers/mipi_dsi/Kconfig.ameba
```kconfig
# Copyright (c) 2026 Realtek Semiconductor Corp.
# SPDX-License-Identifier: Apache-2.0

config MIPI_DSI_AMEBA
	bool "Realtek Ameba MIPI-DSI Host Controller"
	default y
	depends on DT_HAS_REALTEK_AMEBA_MIPI_DSI_ENABLED
	help
	  Enable the Realtek Ameba MIPI-DSI host controller driver.  Drives the
	  on-SoC DSI/D-PHY block that feeds the LCDC video output; pairs with
	  the Ameba LCDC display driver.
```

## drivers/otp/Kconfig.ameba
```kconfig
# Copyright (c) 2026 Realtek Semiconductor Corp.
# SPDX-License-Identifier: Apache-2.0

config OTP_AMEBA
	bool "Realtek Ameba OTP driver"
	default y
	depends on DT_HAS_REALTEK_AMEBA_OTP_ENABLED
	help
	  Enable the driver for the OTP physical area of Realtek Ameba SoCs.
```

## drivers/rtc/Kconfig.ameba
```kconfig
# Copyright (c) 2024 Realtek Semiconductor Corp.
# SPDX-License-Identifier: Apache-2.0

config RTC_AMEBA
	bool "AMEBA RTC driver"
	default y
	depends on DT_HAS_REALTEK_AMEBA_RTC_ENABLED
	select CLOCK_CONTROL
	help
	  Build Real-Time Clock (RTC) driver for AMEBA SoCs.
```

## dts/bindings/cpu/arm,cortex-a32.yaml
```yaml
# Copyright (c) 2026 Realtek Semiconductor Corp.
# SPDX-License-Identifier: Apache-2.0

description: ARM Cortex-A32 CPU

compatible: "arm,cortex-a32"

include: cpu.yaml
```

## dts/bindings/display/realtek,ameba-lcdc-dsi.yaml
```yaml
# Copyright (c) 2026 Realtek Semiconductor Corp.
# SPDX-License-Identifier: Apache-2.0

description: |
  Realtek Ameba LCDC display controller, MIPI-DSI output path (AmebaSmart).

  Width/height are declared on this node (display-controller.yaml) and on the
  panel node under the MIPI-DSI bus.  Use a preprocessor macro in the board
  overlay to define them once and assign to both nodes.

compatible: "realtek,ameba-lcdc-dsi"

include: [display-controller.yaml]

properties:
  reg:
    required: true

  interrupts:
    required: true

  clocks:
    required: true
```

## dts/bindings/display/realtek,gh7002.yaml
```yaml
# Copyright (c) 2026 Realtek Semiconductor Corp.
# SPDX-License-Identifier: Apache-2.0

description: |
  GH7002 1024x600 MIPI-DSI panel controller (Driver IC: gh7002-01, Screen: hj7001-02).

  2-lane MIPI-DSI, RGB888 output at 60 Hz. Reset pin is active-low: pulled LOW
  for 15 ms, then released; the panel needs 120 ms after reset release before
  the first init command.

  Example DTS node (AmebaSmart EVB, PA_14 reset):

    &mipi_dsi {
        status = "okay";
        realtek,frame-rate = <60>;

        gh7002: gh7002@0 {
            compatible = "realtek,gh7002";
            reg = <0x0>;
            reset-gpios = <&gpioa 14 GPIO_ACTIVE_LOW>;
            data-lanes = <2>;
            pixel-format = <MIPI_DSI_PIXFMT_RGB888>;
            width = <1024>;
            height = <600>;
            status = "okay";

            display-timings {
                compatible = "zephyr,panel-timing";
                hsync-len = <10>;
                hback-porch = <60>;
                hfront-porch = <120>;
                vsync-len = <10>;
                vback-porch = <10>;
                vfront-porch = <12>;
                hsync-active = <0>;
                vsync-active = <0>;
                de-active = <1>;
                pixelclk-active = <0>;
            };
        };
    };

compatible: "realtek,gh7002"

include: [mipi-dsi-device.yaml, display-controller.yaml]

properties:
  reset-gpios:
    type: phandle-array
    description: |
      Active-low hardware reset. The GPIO is driven HIGH then LOW for 15 ms,
      then released HIGH; the panel requires 120 ms after de-assertion before
      the first init command.
```

## dts/bindings/display/sitronix,st7701s.yaml
```yaml
# Copyright (c) 2026 Realtek Semiconductor Corp.
# SPDX-License-Identifier: Apache-2.0

description: |
  Sitronix ST7701S MIPI-DSI panel controller.

  Resolution is not fixed by this binding: the active area comes from the
  standard "width"/"height" properties (via display-controller.yaml), so the
  same driver serves any ST7701S module by setting those values together with
  the matching panel timings in the device tree.

  The ST7701S shares the ST7701 controller programming model, including the
  CMD2 bank-select command (0xFF 0x77 0x01 ...) used to reach the extended
  register banks; the two differ only in register values, not in the command
  set.  The built-in initialisation sequence is tuned for the 480RGB x 800
  module on the AmebaSmart EVB and may need adjustment for other panels using
  the same controller.

compatible: "sitronix,st7701s"

include: [mipi-dsi-device.yaml, display-controller.yaml]

properties:
  reset-gpios:
    type: phandle-array
    description: |
      Active-low hardware reset.  The GPIO is driven LOW for 10 ms then
      HIGH; the panel requires 120 ms after de-assertion before the first
      command.
```

## dts/bindings/mipi-dsi/realtek,ameba-mipi-dsi.yaml
```yaml
# Copyright (c) 2026 Realtek Semiconductor Corp.
# SPDX-License-Identifier: Apache-2.0

description: |
  Realtek Ameba MIPI-DSI host controller.

  Drives the on-SoC DSI/D-PHY block that feeds the LCDC video output.  The
  panel is described as a child node on the mipi-dsi bus; its display timings
  drive both the DSI link rate and the LCDC scan-out.  The host shares a single
  clock gate with the LCDC (CKE=LCDCMIPI_CLOCK, FEN=LCDC), referenced through
  the rcc node.

compatible: "realtek,ameba-mipi-dsi"

include: [mipi-dsi-host.yaml]

properties:
  reg:
    required: true

  clocks:
    required: true

  realtek,frame-rate:
    type: int
    required: true
    description: |
      Target panel refresh rate in Hz.  Drives the D-PHY high-speed
      data-lane frequency calculation.  Must be set explicitly in the
      board overlay to match the connected panel's timing.
```

## dts/bindings/otp/realtek,ameba-otp.yaml
```yaml
# Copyright (c) 2026 Realtek Semiconductor Corp.
# SPDX-License-Identifier: Apache-2.0

description: |
  Realtek Ameba OTP (one-time programmable) memory controller.

  The controller exposes two views of the same OTP array, each described by a
  child node. The driver recognises the children by node name:

    - "physical": the raw OTP bytes. Bits can only be programmed from 1 to 0.
    - "logical": the logical map, rebuilt from an append-only entry log stored
      in the first part of the physical area. A logical byte can be rewritten
      any number of times, but every rewrite consumes physical space that can
      never be reclaimed. The map also holds factory calibration data (Wi-Fi,
      BT, ...) that cannot be restored once overwritten.

  Example:

    otp: otp@40800000 {
        compatible = "realtek,ameba-otp";
        reg = <0x40800000 0x8000>;
        status = "disabled";

        otp_physical: physical {
            address-range = <0x0 0x800>;
        };

        otp_logical: logical {
            address-range = <0x0 0x400>;
        };
    };

compatible: "realtek,ameba-otp"

include: base.yaml

properties:
  reg:
    required: true

child-binding:
  description: OTP view ("physical" or "logical")

  properties:
    address-range:
      type: array
      required: true
      description: |
        Range of the view as <start size>, both in bytes. The offsets used by
        otp_read() and otp_program() are relative to start, so <0x0 0x400>
        covers the offsets 0x0 to 0x3ff of the view.
```
