/*
 * Copyright (c) 2019 Intel Corporation.
 *
 * SPDX-License-Identifier: Apache-2.0
 */
/dts-v1/;

#include "stark_hifi4_upg1409.dtsi"

/ {
	model = "xt-sim";
	compatible = "cdns,xtensa-stark_hifi4_upg1409";

	chosen {
		zephyr,sram = &sram0;
	};
};

&cpu0 {
	clock-frequency = <10000000>;
};
