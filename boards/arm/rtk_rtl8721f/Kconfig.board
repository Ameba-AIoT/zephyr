## boards/arm/rtk_rtl8721f/Kconfig.board
```kconfig
# Kconfig - Formosa board configuration
#
# Copyright (c) 2023 Realtek Semiconductor, Inc.
# SPDX-License-Identifier: Apache-2.0

config BOARD_RTK_RTL8721F
        bool "RealTek RTL8721F Board"
        depends on SOC_AMEBADPLUSX
```

## boards/arm/rtk_rtl8721f/Kconfig.defconfig
```kconfig
# Kconfig - Formosa board configuration
#
# Copyright (c) 2023 Realtek Semiconductor, Inc.
# SPDX-License-Identifier: Apache-2.0

if BOARD_RTK_RTL8721F

config BOARD
        default "RTK RTL8721F"

config BUILD_WITH_TFM
        default y if TRUSTED_EXECUTION_NONSECURE

endif
```

## boards/arm/rtk_rtl8721f/rtk_rtl8721f_defconfig
```kconfig
# Copyright (c) 2023 Realtek Semiconductor, Inc.
# SPDX-License-Identifier: Apache-2.0

CONFIG_SOC_SERIES_AMEBADPLUS=y
CONFIG_SOC_AMEBADPLUSX=y
CONFIG_BOARD_RTK_RTL8721F=y
CONFIG_RUNTIME_NMI=y


#CONFIG_SYS_CLOCK_HW_CYCLES_PER_SEC=25000000
#CONFIG_SYS_CLOCK_TICKS_PER_SEC=100
CONFIG_CORTEX_M_SYSTICK=y

# enable uart
CONFIG_SERIAL=y

# console
CONFIG_CONSOLE=y
CONFIG_UART_CONSOLE=y
```

## boards/arm/rtl872xda_evb/Kconfig.board
```kconfig
# Copyright (c) 2024 Realtek Semiconductor Corp.
# SPDX-License-Identifier: Apache-2.0

config BOARD_REALTEK_RTL872XDA_EVB
        bool "Realtek AmebaDplus RTL872XDA EVB"
        depends on SOC_AMEBADPLUS
```

## boards/arm/rtl872xda_evb/Kconfig.defconfig
```kconfig
# Copyright (c) 2024 Realtek Semiconductor Corp.
# SPDX-License-Identifier: Apache-2.0

if BOARD_REALTEK_RTL872XDA_EVB

config BOARD
        default "Realtek AmebaDplus RTL872XDA EVB"

config BUILD_WITH_TFM
        default y if TRUSTED_EXECUTION_NONSECURE

endif
```

## boards/arm/rtl872xda_evb/rtl872xda_evb_defconfig
```kconfig
# Copyright (c) 2024 Realtek Semiconductor Corp.
# SPDX-License-Identifier: Apache-2.0

CONFIG_SOC_SERIES_AMEBADPLUS=y
CONFIG_SOC_AMEBADPLUS=y
CONFIG_BOARD_REALTEK_RTL872XDA_EVB=y
CONFIG_RUNTIME_NMI=y

CONFIG_CORTEX_M_SYSTICK=y

# enable rcc
CONFIG_CLOCK_CONTROL=y
CONFIG_PINCTRL=y

# enable uart
CONFIG_SERIAL=y

# console
CONFIG_CONSOLE=y
CONFIG_UART_CONSOLE=y

# enable stdout and printk
CONFIG_STDOUT_CONSOLE=y
CONFIG_PRINTK=y
CONFIG_CONSOLE_HANDLER=y
CONFIG_CONSOLE_SUBSYS=y

CONFIG_HWINFO=y
CONFIG_SHELL=y
CONFIG_LOG=y

# enable trng
CONFIG_ENTROPY_GENERATOR=y
CONFIG_DMA=y
CONFIG_FLASH=y
# CONFIG_SPI=y
CONFIG_I2C=y
CONFIG_WATCHDOG=y

# CONFIG_GPIO=y
CONFIG_RTC=y
CONFIG_ADC=y
CONFIG_LED_STRIP=y
CONFIG_COUNTER=y
CONFIG_PWM=y
# CONFIG_I2S=y
# CONFIG_AUDIO=y
# CONFIG_AUDIO_DMIC=y
CONFIG_CRYPTO=y

# enable captouch
CONFIG_INPUT=y

#TODO
CONFIG_DYNAMIC_INTERRUPTS=y
```

## boards/arm/sheipa/Kconfig.board
```kconfig
# Kconfig - Formosa board configuration
#
# Copyright (c) 2023 Realtek Semiconductor, Inc.
# SPDX-License-Identifier: Apache-2.0

config BOARD_SHEIPA
        bool "Sheipa Platform Board"
        select QEMU_TARGET
```

## boards/arm/sheipa/Kconfig.defconfig
```kconfig
# Kconfig - Formosa board configuration
#
# Copyright (c) 2023 Realtek Semiconductor, Inc.
# SPDX-License-Identifier: Apache-2.0

if BOARD_SHEIPA

config BOARD
        default "sheipa"

config BUILD_WITH_TFM
        default y if TRUSTED_EXECUTION_NONSECURE

endif
```

## boards/arm/sheipa/sheipa_km4_defconfig
```kconfig
# Copyright (c) 2023 Realtek Semiconductor, Inc.
# SPDX-License-Identifier: Apache-2.0

CONFIG_SOC_SERIES_SHEIPA=y
CONFIG_SOC_SHEIPA_KM4=y
CONFIG_BOARD_SHEIPA=y
CONFIG_RUNTIME_NMI=y
CONFIG_CORTEX_M_SYSTICK=y

#CONFIG_SYS_CLOCK_HW_CYCLES_PER_SEC=25000000
#CONFIG_SYS_CLOCK_TICKS_PER_SEC=100
CONFIG_CORTEX_M_SYSTICK=y

# enable uart
CONFIG_SERIAL=y

# console
CONFIG_CONSOLE=y
CONFIG_UART_CONSOLE=y

CONFIG_QEMU_ICOUNT_SHIFT=7
```

## boards/realtek/rtl8721f_evb/board.yml
```yaml
board:
  name: rtl8721f_evb
  vendor: realtek
  socs:
    - name: rtl8721f
      variants:
        - name: mcuboot
        - name: ns
```

## boards/realtek/rtl8721f_evb/rtl8721f_evb_mcuboot_defconfig
```kconfig
# Copyright (c) 2025 Realtek Semiconductor Corp.
# SPDX-License-Identifier: Apache-2.0

# Configurations in this file only work for device rtl8721f_evb variants mcuboot
# Configurations here would overwrite configurations in Kconfig.defconfig

CONFIG_UPDATEABLE_IMAGE_NUMBER=2
```

## boards/realtek/rtl8721f_evb/rtl8721f_evb_ns_defconfig
```kconfig
# Copyright (c) 2024 Realtek Semiconductor Corp.
# SPDX-License-Identifier: Apache-2.0

# Configurations in this file only work for plain device rtl8721f_evb
# Configurations here would overwrite configurations in Kconfig.defconfig
# Configurations for all rtl8721f_evb variants(like mcuboot) are supposed to be set in Kconfig.defconfig

# This Board implies building Non-Secure firmware
CONFIG_TRUSTED_EXECUTION_NONSECURE=y

# Disable TFM BL2 since it is not supported
CONFIG_TFM_BL2=n
```

## boards/realtek/rtl872xd_evb/rtl872xd_evb_defconfig
```kconfig
# Copyright (c) 2024 Realtek Semiconductor Corp.
# SPDX-License-Identifier: Apache-2.0

CONFIG_RUNTIME_NMI=y

CONFIG_CORTEX_M_SYSTICK=y

# Enable hardware stack protection
CONFIG_HW_STACK_PROTECTION=y

# This board implies building Non-Secure firmware
CONFIG_TRUSTED_EXECUTION_NONSECURE=y

# enable rcc
CONFIG_CLOCK_CONTROL=y

# enable uart
CONFIG_SERIAL=y

# enable console for stdout
CONFIG_CONSOLE=y
CONFIG_UART_CONSOLE=y

# enable GPIO
CONFIG_GPIO=y

CONFIG_NOCACHE_MEMORY=y
```

## boards/realtek/rtl872xda_evb/rtl872xda_evb_defconfig
```kconfig
# Copyright (c) 2024 Realtek Semiconductor Corp.
# SPDX-License-Identifier: Apache-2.0

CONFIG_RUNTIME_NMI=y

CONFIG_CORTEX_M_SYSTICK=y

# enable rcc
CONFIG_CLOCK_CONTROL=y
CONFIG_PINCTRL=y

# enable uart
CONFIG_SERIAL=y

# console
CONFIG_CONSOLE=y
CONFIG_UART_CONSOLE=y

# enable stdout and printk
CONFIG_STDOUT_CONSOLE=y
CONFIG_PRINTK=y
CONFIG_CONSOLE_HANDLER=y
CONFIG_CONSOLE_SUBSYS=y

CONFIG_HWINFO=y
CONFIG_HWINFO_SHELL=y
CONFIG_SHELL=y
CONFIG_LOG=y

# enable trng
CONFIG_ENTROPY_GENERATOR=y
CONFIG_DMA=y
CONFIG_FLASH=y
# CONFIG_SPI=y
CONFIG_I2C=y
CONFIG_WATCHDOG=y

# CONFIG_GPIO=y
CONFIG_RTC=y
CONFIG_ADC=y
CONFIG_LED_STRIP=y
CONFIG_COUNTER=y
CONFIG_PWM=y
CONFIG_PWM_CAPTURE=y
CONFIG_I2S=y
CONFIG_AUDIO=y
CONFIG_AUDIO_DMIC=y
CONFIG_CRYPTO=y

# enable captouch
CONFIG_INPUT=y

# enable wifi
#CONFIG_WIFI=y
#CONFIG_NET_L2_ETHERNET=y
#CONFIG_NET_IPV6=y
#CONFIG_NET_UDP_CHECKSUM=y
#CONFIG_REALTEK_AMEBA_HAL_LIB=y
#CONFIG_REALTEK_AMEBA_ZEPHYR_WIFI=y
#CONFIG_WLAN=y
#CONFIG_AS_INIC_AP=y
#CONFIG_REALTEK_AMEBA_WIFI_INIC=y
#CONFIG_ETH_DRIVER=y
#CONFIG_ETH_PHY_DRIVER=y
#CONFIG_NET_DHCPV4=y
#CONFIG_WIFI_AMEBA=y
#CONFIG_NETWORKING=y
#CONFIG_NET_L2_WIFI_SHELL=y
#CONFIG_NET_L2_WIFI_MGMT=y
#CONFIG_NET_IPV4=y
#CONFIG_NET_SHELL=y
#CONFIG_NET_UDP=y
#CONFIG_NET_MGMT=y
#CONFIG_NET_DHCPV4_SERVER=y
#CONFIG_NET_IF_MAX_IPV4_COUNT=2
#zperf todo
#tcp
#CONFIG_NET_TCP=y

#TODO
CONFIG_DYNAMIC_INTERRUPTS=y
```

## boards/realtek/rtl8735b_evb/Kconfig.rtl8735b_evb
```kconfig
# Copyright (c) 2024 Realtek Semiconductor Corp.
# SPDX-License-Identifier: Apache-2.0

config BOARD_RTL8735B_EVB
	select SOC_AMEBAPRO2
```

## boards/realtek/rtl8735b_evb/rtl8735b_evb_defconfig
```kconfig
# Copyright (c) 2024 Realtek Semiconductor Corp.
# SPDX-License-Identifier: Apache-2.0

CONFIG_RUNTIME_NMI=y

CONFIG_CORTEX_M_SYSTICK=y

# Enable hardware stack protection
CONFIG_HW_STACK_PROTECTION=y

# enable uart
CONFIG_SERIAL=y

# console
CONFIG_CONSOLE=y
CONFIG_UART_CONSOLE=y

# enable stdout and printk
CONFIG_STDOUT_CONSOLE=y
CONFIG_PRINTK=y
CONFIG_CONSOLE_HANDLER=y
CONFIG_CONSOLE_SUBSYS=y

# CONFIG_HWINFO=y
# CONFIG_HWINFO_SHELL=y
CONFIG_SHELL=y
CONFIG_LOG=y

CONFIG_ENTROPY_GENERATOR=y
# CONFIG_DMA=y
CONFIG_FLASH=y
CONFIG_SPI=y
CONFIG_I2C=y
# CONFIG_WATCHDOG=y
# CONFIG_GPIO=y
# CONFIG_RTC=y
# CONFIG_ADC=y
# CONFIG_LED_STRIP=y
# CONFIG_COUNTER=y
# CONFIG_PWM=y
# CONFIG_PWM_CAPTURE=y
# CONFIG_I2S=y
# CONFIG_AUDIO=y
# CONFIG_AUDIO_DMIC=y
# CONFIG_CRYPTO=y

CONFIG_REALTEK_AMEBA_HAL_LIB=y
CONFIG_NEWLIB_LIBC=y

CONFIG_NETWORKING=y
CONFIG_NET_IPV4=y
CONFIG_NET_IPV6=y
CONFIG_NET_TCP=y
CONFIG_NET_UDP=y
CONFIG_NET_UDP_CHECKSUM=y
CONFIG_NET_DHCPV4=y
# CONFIG_NET_DHCPV4_SERVER=y
CONFIG_NET_MGMT=y
CONFIG_NET_LOG=y
CONFIG_NET_SHELL=y

CONFIG_NET_SOCKETS=y
CONFIG_POSIX_API=y

CONFIG_NET_DRIVERS=y
CONFIG_NET_LOOPBACK=y
CONFIG_NET_L2_ETHERNET=y
# CONFIG_ETH_DRIVER=y
# CONFIG_ETH_PHY_DRIVER=y

CONFIG_DYNAMIC_INTERRUPTS=y
CONFIG_NOCACHE_MEMORY=y
CONFIG_XIP=n

CONFIG_HEAP_MEM_POOL_SIZE=1048576
```

## boards/xtensa/xt-sim_stark_hifi4_upg1409/Kconfig.defconfig
```kconfig
# Copyright (c) 2016 Cadence Design Systems, Inc.
# SPDX-License-Identifier: Apache-2.0

config BOARD
	default "xt-sim_stark_hifi4_upg1409"

config IPM_CONSOLE_STACK_SIZE
	default 2048 if IPM_CONSOLE_RECEIVER
```

## drivers/audio/Kconfig.amebapro2_dmic
```kconfig
# Copyright (c) 2024 Realtek Semiconductor Corp.
# SPDX-License-Identifier: Apache-2.0

config AUDIO_AMEBAPRO2_DMIC
	bool "AmebaPro2 Digital PDM microphone support"
	default y
	depends on DT_HAS_REALTEK_AMEBAPRO2_DMIC_ENABLED
	help
	  Enable AmebaPro2 digital microphone (DMIC) support using the
	  internal SPORT peripheral for PDM audio capture
```

## drivers/disk/Kconfig.sdmmc_amebapro2
```kconfig
# AmebaPro2 sd card driver configuration options

# Copyright (c) 2024 Realtek Semiconductor Corp.
# SPDX-License-Identifier: Apache-2.0

config SDMMC_AMEBAPRO2
	bool "Realtek AmebaPro2 SD Driver"
	depends on DT_HAS_REALTEK_AMEBAPRO2_SDMMC_ENABLED && DISK_ACCESS
	default y
	help
		Enable support for the Realtek AmebaPro2 sd card driver.
```

## drivers/entropy/Kconfig.amebapro2
```kconfig
# AMEBA entropy generator driver configuration

# Copyright (c) 2024 Realtek Semiconductor Corp.
# SPDX-License-Identifier: Apache-2.0

config ENTROPY_AMEBAPRO2_TRNG
	bool "AmebaPro2 entropy number generator driver"
	default y
	depends on DT_HAS_REALTEK_AMEBAPRO2_TRNG_ENABLED
	select ENTROPY_HAS_DRIVER
	help
	  Enable entropy number generator support on the AMEBA family of processors.
```

## drivers/ethernet/Kconfig.ameba
```kconfig
# Copyright (c) 2025 Realtek Semiconductor Corp.
# SPDX-License-Identifier: Apache-2.0

# AMEBA Ethernet driver configuration options
menuconfig ETH_AMEBA
	bool "AMEBA Ethernet driver"
	default y
	depends on DT_HAS_REALTEK_AMEBA_ETH_ENABLED
	select MDIO
	help
	  Enable AMEBA Ethernet driver.

if ETH_AMEBA

config ETH_AMEBA_RX_THREAD_STACK_SIZE
	int "AMEBA Ethernet receive thread stack size"
	default 768

config ETH_AMEBA_RX_THREAD_PRIORITY
	int "AMEBA Ethernet receive thread priority"
	default 2

endif # ETH_AMEBA
```

## drivers/flash/Kconfig.amebapro2
```kconfig
# Copyright (c) 2024 Realtek Semiconductor Corp.
# SPDX-License-Identifier: Apache-2.0

menuconfig SOC_FLASH_AMEBAPRO2
	bool "AmebaPro2 flash driver"
	default y
	depends on DT_HAS_REALTEK_AMEBAPRO2_FLASH_CONTROLLER_ENABLED
	select FLASH_HAS_DRIVER_ENABLED
	select FLASH_HAS_PAGE_LAYOUT
	select FLASH_HAS_EXPLICIT_ERASE
	help
	  Enable AmebaPro2 internal flash driver.
```

## drivers/gpio/Kconfig.ameba
```kconfig
# Copyright (c) 2024 Realtek Semiconductor Corp.
# SPDX-License-Identifier: Apache-2.0

config GPIO_AMEBA
	bool "GPIO controller driver for Realtek Ameba series SoC"
	default y
	depends on DT_HAS_REALTEK_AMEBA_GPIO_ENABLED
	help
	  Enable GPIO controller driver for Realtek Ameba series SoC
```
