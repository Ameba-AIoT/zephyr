/*
 * Copyright (c) 2023 Realtek Semiconductor, Inc.
 *
 * SPDX-License-Identifier: Apache-2.0
 */

/dts-v1/;

#include <realtek/amebadplus/amebadplus.dtsi>

 / {
	model = "RealTek rtl8721f";
	compatible = "realtek,rtk_rtl8721f";

	chosen {
		zephyr,console = &uart0;
		zephyr,sram = &sram0;
		zephyr,flash = &flash0;
	};
};
